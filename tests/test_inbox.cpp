/*
 * test_inbox.cpp — the parking spot for positions that arrive before you open the book.
 *
 * The two behaviours worth guarding are both silent when wrong:
 *
 *   - a packet signed with SOMEBODY ELSE'S passcode must be taken out of the Chats list (it
 *     is machine traffic, not a message) and must never, ever be applied; and
 *   - a position that arrives while the book is shut must still be there when it is opened,
 *     because a LoRa round trip does not fit inside the moment you press Sync.
 *
 * Packets here are the real ones from the interop vectors, generated by running COVEY's own
 * booksync.py — so this exercises the same bytes the radio will carry.
 */
#include "../WiPhone/booksync_inbox.h"
#include "vectors_booksync.h"

#include <stdio.h>
#include <string.h>

static int g_pass = 0, g_fail = 0;
static const char* g_group = "";

static void group(const char* name) {
  g_group = name;
  printf("\n\033[1m%s\033[0m\n", name);
}

static void ok(bool cond, const char* what) {
  if (cond) {
    g_pass++;
  } else {
    g_fail++;
    printf("  \033[31mFAIL\033[0m %s :: %s\n", g_group, what);
  }
}

static void eqU32(unsigned long got, unsigned long want, const char* what) {
  if (got == want) {
    g_pass++;
    return;
  }
  g_fail++;
  printf("  \033[31mFAIL\033[0m %s :: %s  want=%lu got=%lu\n", g_group, what, want, got);
}

// The first record vector, which is a full real packet with known contents.
static const BsRecVec* recVec(const char* label) {
  for (int i = 0; i < BS_REC_VEC_N; i++) {
    if (strcmp(BS_REC_VECS[i].label, label) == 0) {
      return &BS_REC_VECS[i];
    }
  }
  return NULL;
}

static void keyFor(const char* passcode, uint8_t key[32]) {
  bookSyncDeriveKey(passcode, key);
}

static void testParkAndFind() {
  group("a position parked before the book is opened is still there after");

  const BsRecVec* v = &BS_REC_VECS[0];
  uint8_t key[32];
  keyFor(v->passcode, key);

  bookSyncInboxInit();
  eqU32((unsigned long)bookSyncInboxCount(), 0, "starts empty");

  ok(bookSyncInboxPush(v->meshText, 0x1234abcd, 1000), "a real packet parks");
  eqU32((unsigned long)bookSyncInboxCount(), 1, "one parked");

  // The book is opened later and asks for anything about it.
  const char* ids[1] = { v->reducedId };
  BookSyncRecord got;
  uint32_t from = 0;
  int idx = bookSyncInboxFindFor(key, ids, 1, &got, &from);
  ok(idx == 0, "found once the book is open");
  eqU32(got.spine, v->reducedSpine, "spine survived the wait");
  eqU32(got.offset, v->reducedOffset, "offset survived the wait");
  eqU32(from, 0x1234abcd, "and we know who sent it");

  ok(bookSyncInboxCount() == 1, "finding does not consume it");
  bookSyncInboxRemove(idx);
  eqU32((unsigned long)bookSyncInboxCount(), 0, "acting on it does");
}

static void testWrongPasscodeIsDivertedButNeverApplied() {
  group("someone else's passcode: out of Chats, and never applied");

  bookSyncInboxInit();
  for (int i = 0; i < (int)(sizeof(BS_BAD_VECS) / sizeof(BS_BAD_VECS[0])); i++) {
    const BsBadVec* b = &BS_BAD_VECS[i];
    bool parked = bookSyncInboxPush(b->text, 1, 100);
    bool looksLikeSync = bookSyncIsSyncText(b->text);
    char what[96];
    snprintf(what, sizeof(what), "%s: parked exactly when it looks like sync traffic",
             b->label);
    ok(parked == looksLikeSync, what);
  }
  ok(bookSyncInboxCount() > 0, "some of them WERE diverted out of the chat list");

  /* Every one of them must fail to match under the honest key: they are either malformed or
   * signed with a different passcode. This is the assertion that stops a stranger moving
   * your place in a book. */
  uint8_t key[32];
  keyFor("vector-passcode-a", key);
  const char* ids[1] = { BS_REC_VECS[0].reducedId };
  BookSyncRecord got;
  int idx = bookSyncInboxFindFor(key, ids, 1, &got, NULL);
  ok(idx < 0, "and not one of them matches");
}

static void testNewestWins() {
  group("the newest reading event wins, not the newest arrival");

  uint8_t key[32];
  keyFor("vector-passcode-a", key);
  const char* ids[1] = { "id:some-book" };

  BookSyncRecord a, b;
  bookSyncMakeRecord(&a, ids, 1, 3, 100, 0.25, 1000, "COVEY", "aaaaaaaa");
  bookSyncMakeRecord(&b, ids, 1, 7, 900, 0.75, 5000, "COVEY", "bbbbbbbb");
  char ta[BOOKSYNC_MESH_TEXT_MAX], tb[BOOKSYNC_MESH_TEXT_MAX];
  ok(bookSyncPackMesh(&a, key, ta, sizeof(ta)), "packed the older one");
  ok(bookSyncPackMesh(&b, key, tb, sizeof(tb)), "packed the newer one");

  // Park the NEWER one first, so arrival order is the opposite of reading order.
  bookSyncInboxInit();
  bookSyncInboxPush(tb, 1, 500);
  bookSyncInboxPush(ta, 1, 900);

  BookSyncRecord got;
  int idx = bookSyncInboxFindFor(key, ids, 1, &got, NULL);
  ok(idx >= 0, "one of them matches");
  eqU32(got.spine, 7, "the later page turn wins despite arriving first");
  eqU32(got.turnedAt, 5000, "and it is the later turnedAt");
}

static void testHousekeeping() {
  group("the inbox does not fill up with the same news");

  uint8_t key[32];
  keyFor("vector-passcode-a", key);
  const char* ids[1] = { "id:dupe-book" };
  BookSyncRecord r;
  bookSyncMakeRecord(&r, ids, 1, 1, 2, 0.5, 77, "COVEY", "cccccccc");
  char text[BOOKSYNC_MESH_TEXT_MAX];
  bookSyncPackMesh(&r, key, text, sizeof(text));

  bookSyncInboxInit();
  for (int i = 0; i < 10; i++) {
    bookSyncInboxPush(text, 1, 100 + i);
  }
  eqU32((unsigned long)bookSyncInboxCount(), 1, "a resend replaces rather than stacks");

  // Different books must not push each other out until the inbox is genuinely full.
  bookSyncInboxInit();
  for (int i = 0; i < BOOKSYNC_INBOX_MAX + 2; i++) {
    char id[32];
    snprintf(id, sizeof(id), "id:book-%d", i);
    const char* one[1] = { id };
    BookSyncRecord x;
    bookSyncMakeRecord(&x, one, 1, (unsigned)i, 0, 0.1, 10 + i, "COVEY", "dddddddd");
    char t[BOOKSYNC_MESH_TEXT_MAX];
    bookSyncPackMesh(&x, key, t, sizeof(t));
    bookSyncInboxPush(t, 1, 200 + i);
  }
  eqU32((unsigned long)bookSyncInboxCount(), BOOKSYNC_INBOX_MAX, "capped");

  // The oldest went; the newest stayed.
  const char* newest[1] = { "id:book-5" };
  BookSyncRecord got;
  ok(bookSyncInboxFindFor(key, newest, 1, &got, NULL) >= 0, "the newest book is still parked");
  const char* oldest[1] = { "id:book-0" };
  ok(bookSyncInboxFindFor(key, oldest, 1, &got, NULL) < 0, "the oldest was evicted");

  ok(!bookSyncInboxPush("just a normal chat message", 1, 1), "a chat message is not parked");
  ok(!bookSyncInboxPush(NULL, 1, 1), "and neither is nothing");
}

static void testWrongBook() {
  group("a position for another book is left alone");

  const BsRecVec* v = &BS_REC_VECS[0];
  uint8_t key[32];
  keyFor(v->passcode, key);
  bookSyncInboxInit();
  bookSyncInboxPush(v->meshText, 1, 10);

  const char* other[1] = { "id:a-different-book-entirely" };
  BookSyncRecord got;
  ok(bookSyncInboxFindFor(key, other, 1, &got, NULL) < 0, "no match for the wrong book");
  eqU32((unsigned long)bookSyncInboxCount(), 1, "and it stays parked for the right one");
}

int main() {
  (void)recVec;
  testParkAndFind();
  testWrongPasscodeIsDivertedButNeverApplied();
  testNewestWins();
  testHousekeeping();
  testWrongBook();
  printf("\n%s%d passed, %d failed\033[0m\n", g_fail ? "\033[31m" : "\033[32m", g_pass, g_fail);
  return g_fail ? 1 : 0;
}
